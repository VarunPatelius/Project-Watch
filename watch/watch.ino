#include <ESP8266WiFi.h>
#include <NTPClient.h>
#include <WiFiUdp.h>
#include <time.h>
#include <Arduino.h>
#include <ESP8266HTTPClient.h>
#include <ArduinoJson.h>
#include <WiFiClient.h>
#include <Arduino_GFX_Library.h>
#include "settings.h"

#if defined(DISPLAY_DEV_KIT)
Arduino_GFX *gfx = create_default_Arduino_GFX();
#else /* !defined(DISPLAY_DEV_KIT) */
Arduino_DataBus *bus = new Arduino_ESP8266SPI(2 /* DC */, 15 /* CS */);
Arduino_GFX *gfx = new Arduino_GC9A01(bus, 16 /* RST */, 0 /* rotation */, true /* IPS */);

#endif /* !defined(DISPLAY_DEV_KIT) */

WiFiUDP ntpUDP;
NTPClient timeClient(ntpUDP, "pool.ntp.org");

String weekDays[7]={"Sunday", "Monday", "Tuesday", "Wednesday", "Thursday", "Friday", "Saturday"};

static int16_t w, h;
static int16_t hh, mm, ss;
static unsigned long targetTime; // next action time

String hourComponent;
String minuteComponent;
String weatherComponent;
String newsComponent;

WiFiClient wifiClient;
DynamicJsonDocument doc(24576);

const unsigned char weatherIcon [] PROGMEM = {
	// '02d@2x, 55x55px
	0x00, 0x00, 0x00, 0x00, 0x00, 0x00, 0x00, 0x00, 0x00, 0x00, 0x00, 0x00, 0x00, 0x00, 0x00, 0x00, 
	0x00, 0x00, 0x00, 0x00, 0x00, 0x00, 0x00, 0x00, 0x00, 0x00, 0x00, 0x00, 0x00, 0x00, 0x00, 0x00, 
	0x00, 0x00, 0x00, 0x00, 0x00, 0x00, 0x00, 0x00, 0x00, 0x00, 0x00, 0x00, 0x00, 0x00, 0x00, 0x00, 
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	0x00, 0x00, 0x00, 0x00, 0x00, 0x00, 0x00, 0x00, 0x00, 0x00, 0x00, 0x00, 0x00, 0x00, 0x00, 0x00, 
	0x00
};

void setup() {
    Serial.begin(115200);
  
    // Connect to Wi-Fi
    Serial.print("Connecting to ");
    Serial.println(ssid);
    WiFi.begin(ssid, password);
    while (WiFi.status() != WL_CONNECTED) {
      delay(500);
      Serial.print(".");
    }

    // Initialize a NTPClient to get time
    timeClient.begin();
    timeClient.setTimeOffset(-18000); 
    timeClient.update();

    int currentHour = timeClient.getHours();
    int currentMinute = timeClient.getMinutes();
    int currentSecond = timeClient.getSeconds();

    hh = currentHour;
    mm = currentMinute;
    ss = currentSecond;
     
    gfx->begin();
    gfx->fillScreen(BLACK);

    gfx->drawBitmap(30, 150, weatherIcon, 55, 55, ORANGE);
    weatherComponent = getTemperature();
    putText(95, 168, 3, weatherComponent, ORANGE);

    newsComponent = getHeadline();
    putText(5, 115, 1, newsComponent, CYAN);

    #ifdef TFT_BL
        pinMode(TFT_BL, OUTPUT);
        digitalWrite(TFT_BL, HIGH);
    #endif

    // init LCD constant
    w = gfx->width();
    h = gfx->height();

    targetTime = ((millis() / 1000) + 1) * 1000;
}

void putText(int x, int y, int fontSize, String text, uint16_t color) {
  gfx->setCursor(x, y);
  gfx->setTextColor(color);
  gfx->setTextSize(fontSize);
  gfx->println(text);
}

String formatTime(int16_t minuteOrHour) {
  if (minuteOrHour < 10) {
      return "0" + String(minuteOrHour);
  } 
  return String(minuteOrHour);
}

String getTemperature() {
  HTTPClient http;
  http.begin(wifiClient, weatherURL);
  int httpCode = http.GET();

  String response = http.getString();
  DeserializationError error = deserializeJson(doc, response);

  JsonObject main = doc["main"];
  float mainTemp = main["temp"];

  return String(mainTemp) + "F";
}

String getHeadline() {
  HTTPClient http;
  http.begin(wifiClient, newsURL + "&page=" + String(hh));
  int httpCode = http.GET();

  String response = http.getString();
  DeserializationError error = deserializeJson(doc, response);

  return doc["articles"][0]["title"];
}

void loop() {
    timeClient.update();
    unsigned long epochTime = timeClient.getEpochTime();
    String formattedTime = timeClient.getFormattedTime();
    String weekDay = weekDays[timeClient.getDay()];
   
    hourComponent = formatTime(hh);
    minuteComponent = formatTime(mm);
    String currenttime =  hourComponent + ":" + minuteComponent;
    
    unsigned long cur_millis = millis();

    putText(40, 45, 4, currenttime, WHITE);
    putText(40, 80, 2, weekDay, WHITE);
    
    if (cur_millis >= targetTime) {
        targetTime += 1000;
        ss++; // Advance second

        if (ss == 60) {
            ss = 0;
            mm++; // Advance minute
            putText(40, 45, 4, currenttime, BLACK);

            if (mm % 15 == 0) {
              putText(95, 168, 3, weatherComponent, BLACK);
              weatherComponent = getTemperature();
              putText(95, 168, 3, weatherComponent, ORANGE);

              putText(5, 115, 1, newsComponent, BLACK);
              newsComponent = getHeadline();
              putText(5, 115, 1, newsComponent, CYAN);
            }

            if (mm > 59) {
                mm = 0;
                hh++; // Advance hour
                putText(40, 45, 4, currenttime, BLACK);

                if (hh > 23) {
                    hh = 0; // Reset day
                    putText(40, 80, 2, weekDay, BLACK);
                }
            }
        }
    }
}